## Documentation/devicetree/bindings/i3c/adi,i3c-master.yaml
```yaml
# SPDX-License-Identifier: GPL-2.0
%YAML 1.2
---
$id: http://devicetree.org/schemas/i3c/adi,i3c-master.yaml#
$schema: http://devicetree.org/meta-schemas/core.yaml#

title: Analog Devices I3C Controller

maintainers:
  - Jorge Marques <jorge.marques@analog.com>

allOf:
  - $ref: i3c.yaml#

properties:
  compatible:
    const: adi,i3c-master

  reg:
    maxItems: 1

  clocks:
    maxItems: 1

  clock-names:
    items:
      - const: s_axi_aclk
      - const: i3c_clk

  interrupts:
    maxItems: 1

required:
  - compatible
  - reg
  - clocks
  - clock-names
  - interrupts

unevaluatedProperties: false

examples:
  - |
    i3c_master: i3c@44a00000 {
        compatible = "adi,i3c-master";
        reg = <0x44a00000 0x10000>;
        interrupt-parent = <&intc>;
        interrupts = <0 56 IRQ_TYPE_LEVEL_HIGH>;
        clocks = <&clkc 15>;
        clock-names = "s_axi_aclk";

        #address-cells = <3>;
        #size-cells = <0>;
    };
...
```
